## config/west.yml
```yaml
manifest:
  remotes:
    - name: Ivan-Malinovski
      url-base: https://github.com/Ivan-Malinovski
  projects:
    - name: zmk
      remote: Ivan-Malinovski
      revision: config
      import: app/west.yml
  self:
    path: config
```
